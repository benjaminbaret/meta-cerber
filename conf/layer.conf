## conf/layer.conf
```bitbake
# We have a conf and classes directory, add to BBPATH
BBPATH .= ":${LAYERDIR}"

# We have recipes-* directories, add to BBFILES
BBFILES += "${LAYERDIR}/recipes-*/*/*.bb \
            ${LAYERDIR}/recipes-*/*/*.bbappend"

BBFILE_COLLECTIONS += "meta-cerber"
BBFILE_PATTERN_meta-cerber = "^${LAYERDIR}/"
BBFILE_PRIORITY_meta-cerber = "6"

LAYERDEPENDS_meta-cerber = "core"
LAYERSERIES_COMPAT_meta-cerber = "kirkstone"
```
